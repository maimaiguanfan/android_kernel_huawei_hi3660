## Documentation/devicetree/bindings/leds/backlight/rt8555.txt
```
rt8555 bindings

Required properties:
- compatible		: Must be "realtek,rt8555"

Optional properties:
- name			: Name of backlight device. Default is 'rt8555'.
- rt8555_hw_en_gpio			: GPIO to use to EN pin.
			See Documentation/devicetree/bindings/gpio/gpio.txt
- bl_led_num		: List of enabled channels from 0 to 5.
			See Documentation/devicetree/bindings/leds/common.txt
- rt8555_i2c_bus_id	: I2C bus index
- bl_on_lk_mdelay	: Delay time before working in lk
- bl_on_kernel_mdelay	: Delay time before working in kernel

Example:

	realtek,rt8555{
		compatible = "realtek,rt8555";
		rt8555_support = <1>;
		reg = <0x31>;
		rt8555_i2c_bus_id = <4>;
		rt8555_hw_en_gpio = <10>;
		bl_on_lk_mdelay = <0>;
		bl_on_kernel_mdelay = <0>;
		bl_led_num = <6>;
	};
```

## drivers/char/acm/Kconfig
```kconfig
menu "Access Control Module"

config ACM
	bool "Enable Access Control Module"
	default n
	---help---
	  Access Control Module device driver. The purpose of this module
	  is to prevent third-party apps from deleting media files illegally.
	  This module maintains a white list of apps. Apps in the whitelist
	  can delete media file without any constrains, while apps not int
	  the whitelist may not able to delete media files, instead, the files
	  to be deleted was renamed by file system, and then move to the
	  recycle bin by Gallery.

config ACM_DSM
	bool "Enable ACM dsm features"
	depends on HUAWEI_DSM && ACM
	default n
	---help---
	  Enable dsm features for ACM. Report delete information to dmd.
	  For a deletion, we have much info to report, such as the app
	  that do the delete, the direcotry that the file locates, and the
	  file type, video file or picture. We watched very carefully not to
	  record user privacy information.

config ACM_DEBUG
	bool "Enable ACM debug features"
	depends on ACM
	default n
	---help---
	  Enable debug info print and debugfs features for ACM. When
	  turn on this feature, some debugfs files will be created in
	  the /sys/debug direcotry. You can cat these files to test
	  different part of the ACM.

config ACM_TIME_COST
	bool "Enable ACM time measurement"
	depends on ACM
	default n
	---help---
	  Enable time measurement for ACM. This includes time cost of
	  searching the whitelist, report a record to framework and dmd.
	  This feature is just for debug use. It shouldn't be turned on
	  in user version.
endmenu
```

## drivers/connectivity/hi11xx/Kconfig
```kconfig
#
# Generic huawei hisi misc drivers configuration
#
source "drivers/connectivity/hi11xx/hi1103/Kconfig"
source "drivers/connectivity/hi11xx/hi1103/platform/Kconfig"
source "drivers/connectivity/hi11xx/hi1103/wifi/Kconfig"
source "drivers/connectivity/hi11xx/hi1102a/Kconfig"
source "drivers/connectivity/hi11xx/hi1102a/platform/Kconfig"
source "drivers/connectivity/hi11xx/hi1102a/wifi/Kconfig"
```

## drivers/devkit/tpkit/3_0/panel/elan/Kconfig
```kconfig
#
# huawei touchscreen driver configuration
#
menuconfig ELAN_TS_KIT_3_0
	bool "huawei TS_KIT elan 3.0 drivers"
	default n
	help
	  If you say yes here you get support for huawei touchscreen.
```

## drivers/devkit/tpkit/3_0/panel/parade/Kconfig
```kconfig
#
# huawei touchscreen driver configuration
#
menuconfig PARADE_TS_KIT_3_0
	tristate "huawei  ts kit 3.0 parade drivers"
	default n
	help
	  If you say yes here you get support for huawei touchscreen.
```

## drivers/devkit/tpkit/3_0/panel/st/Kconfig
```kconfig
#
# huawei touchscreen driver configuration
#

menuconfig ST_TS_KIT_3_0
	tristate "TS_KIT ST 3.0 touch drivers"
	default n
	help
	  If you say yes here you get support for huawei touchscreen.
```

## drivers/hisi/hi6xxx/Kconfig
```kconfig
config SND_SOC_HI6XXX_MBHC
	tristate "HI Soc Smartstar Codec Hi6xxx serise support"
```

## drivers/hisi/hispfd/Kconfig
```kconfig
menu "Hisilicon ISP FD"

config HISPFD
    tristate "Hisilicon ISP FD Drivers"
    depends on IOMMU_API
    help
        Hisilicon isp face detect drivers.

config HISPFD_V130
    bool "Hisilicon ISP FD  Drivers for V130"
    depends on HISPFD
    default n
    help
        Hisilicon ISP FD Drivers for V130

endmenu
```

## drivers/hisi/secs_power_ctrl/Kconfig
```kconfig
config HISI_SECS_CTRL
	bool "HISI SECS_CTRL support"
	default n
	help
	  Say yes here to support the HISI SECS CTRL
config SECURE_TEST
	bool "Secure Test"
	default n
	depends on HISI_SECS_CTRL
	help
	  Secure Test: In adb shell, use the following commands to test:
	  "echo 2 > proc/secure-test" to test secure_timer_SR
	  "echo mem > sys/power/state" into SR
	  "echo 3 > proc/secure-test" to test aocc_key_SR
```

## drivers/huawei_platform/audio/high_resistance_hs_det/Kconfig
```kconfig
config HIGH_RESISTANCE_HS_DET
	tristate "high resistance headset detection driver support"
	default n
	---help---
	Say Y here to support the high resistance headset detection
```

## drivers/huawei_platform/audio/usb_audio_power_v600/Kconfig
```kconfig
config USB_AUDIO_POWER_V600
	tristate "Support for usb audio power v600 control"
	default n
	---help---
	 Say Y here if you want to support usb audio power v600 control
```

## drivers/huawei_platform/audio/usb_headset_core/Kconfig
```kconfig
config USB_AUDIO_POWER
	tristate "Support for usb headset core"
	default n
	---help---
	 Say Y here if you want to support usb headset core
```

## drivers/huawei_platform/connectivity/hw_connectivity/Kconfig
```kconfig
menuconfig HWCONNECTIVITY
	tristate "Huawei connectivity OneTrack support"
	default n
	help
	  Say Y here to enable Huawei connectivity OneTrack support. This allows
	  ap to control this module.

menuconfig HW_ABS
	bool "HUAWEI WIFI ABS support"
	default n

menuconfig HW_VOWIFI
	bool "HUAWEI WIFI VOWIFI support"
	default n

menuconfig HW_GET_EXT_SIG
    bool "HUAWEI WIFI HW_GET_EXT_SIG support"
    default n

menuconfig HW_GET_P2P_TX_RATE
    bool "HUAWEI WIFI HW_GET_P2P_TX_RATE support"
    default n
```

## drivers/huawei_platform/emcom/xengine/Kconfig
```kconfig
config HUAWEI_XENGINE
	bool "Huawei xengine feature support"
	default n

config HUAWEI_EMCOM_CHANNEL
	bool "Huawei emcom channel feature support"
	default n
```

## drivers/huawei_platform/hwaa/Kconfig
```kconfig
config HWAA
	bool "HWAA System"
	default y
	help
	Huawei Application Authentication System
```

## drivers/huawei_platform/hwaa/kernel_hook/hwaa/Kconfig
```kconfig
config HWAA
	bool "application authentication"
	default y
	help
		Say yes here to support application authentication.

config HWAA_ENG_DEBUG
	bool "application authentication for eng debug"
	default n
	help
		Say yes here to support application authentication eng debug.
```

## drivers/huawei_platform/power/Kconfig
```kconfig
source "drivers/huawei_platform/power/charger/Kconfig"
source "drivers/huawei_platform/power/power_mesg/Kconfig"
source "drivers/huawei_platform/power/battery/Kconfig"
source "drivers/huawei_platform/power/coul/Kconfig"
source "drivers/huawei_platform/power/hw_kstate/Kconfig"
source "drivers/huawei_platform/power/smpl/Kconfig"
source "drivers/huawei_platform/power/usb_short_circuit_protect/Kconfig"
source "drivers/huawei_platform/power/cpu_buck/Kconfig"
source "drivers/huawei_platform/power/water_check/Kconfig"
source "drivers/huawei_platform/power/buckboost/Kconfig"
source "drivers/huawei_platform/power/buck_boost/Kconfig"
source "drivers/huawei_platform/power/pid_socket/Kconfig"
source "drivers/huawei_platform/power/wifi_filter/Kconfig"
source "drivers/huawei_platform/power/boost_5v/Kconfig"
source "drivers/huawei_platform/power/batt_acr_detect/Kconfig"
source "drivers/huawei_platform/power/power_thermalzone/Kconfig"
source "drivers/huawei_platform/power/power_debug/Kconfig"
source "drivers/huawei_platform/power/vsys_switch/Kconfig"
source "drivers/huawei_platform/power/hardware_monitor/Kconfig"
```

## drivers/huawei_platform/power/battery/Kconfig
```kconfig
source "drivers/huawei_platform/power/battery/battery_ct/Kconfig"
source "drivers/huawei_platform/power/battery/battery_voltage/Kconfig"
source "drivers/huawei_platform/power/battery/battery_temp/Kconfig"
source "drivers/huawei_platform/power/battery/battery_type_identify/Kconfig"
```

## drivers/huawei_platform/power/battery/battery_type_identify/Kconfig
```kconfig
config HUAWEI_BATTERY_TYPE_IDENTIFY
	bool "huawei BATTERY TYPE IDENTIFY"
	default n
	help
	  Say Y here to enable battery type identify driver.
	  This driver provides interfaces to switch channel between
	  adc and onewire communication for identify battery type.
```

## drivers/huawei_platform/power/battery/battery_voltage/Kconfig
```kconfig
config HUAWEI_BATTERY_VOLTAGE
	bool "huawei BATTERY VOLTAGE"
	default n
	help
	  Say Y here to enable battery voltage driver.
	  This driver provides a unified interface
	  for the battery voltage.
	  Currently supported get battery voltage with hkadc.

config HUAWEI_VBAT_HKADC
	bool "huawei vbat hkadc"
	default n
```

## drivers/huawei_platform/power/boost_5v/Kconfig
```kconfig
#
# huawei power boost_5v drivers
#

config BOOST_5V
	bool "huawei power boost with 5v"
	default n
	help
	  Say Y here to enable power boost with 5v driver.
```

## drivers/huawei_platform/power/buck_boost/Kconfig
```kconfig
#
# buck_boost drivers
#

config BUCKBOOST
	bool "buck boost"
	default n
	help
	  Say Y here to enable buck_boost driver.
	  This driver provides a unified interface to buck_boost.
	  This driver is in logic layer.
	  Currently supported device_check and set_vol etc.

config BUCKBOOST_TPS63810
	bool "buckboost tps63810"
	depends on BUCKBOOST
	default n
	help
	  Say Y here to enable buckboost tps63810 driver.
```

## drivers/huawei_platform/power/charger/Kconfig
```kconfig
source "drivers/huawei_platform/power/charger/charger_ap/Kconfig"
source "drivers/huawei_platform/power/charger/charger_sensorhub/Kconfig"
source "drivers/huawei_platform/power/charger/charger_protocol/Kconfig"

config HUAWEI_CHARGER
	bool "huawei charger"
	default n
```
