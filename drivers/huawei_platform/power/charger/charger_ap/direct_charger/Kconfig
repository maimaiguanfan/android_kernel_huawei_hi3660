## drivers/huawei_platform/power/charger/charger_ap/direct_charger/Kconfig
```kconfig
#
# huawei direct charger drivers
#

source "drivers/huawei_platform/power/charger/charger_ap/direct_charger/loadswitch/Kconfig"
source "drivers/huawei_platform/power/charger/charger_ap/direct_charger/switchcap/Kconfig"

config LOADSWITCH
	bool "loadswitch"
	default n
	help
	  Say Y here to enable loadswitch driver.
	  This driver provides a unified interface for loadswtich.
	  Support device:
	  rt9748
	  fpf2283

config SWITCHCAP
	bool "switchcap"
	default n
	help
	  Say Y here to enable switchcap driver.
	  This driver provides a unified interface for switchcap.
	  Support device:
	  bq25970
	  ltc7820

config INA231_FOR_CHARGE
	bool "ina231_for_charge"
	default n
	help
	  Say Y here to enable ina231 driver.
```

## drivers/huawei_platform/power/charger/charger_ap/direct_charger/loadswitch/Kconfig
```kconfig
#
# huawei loadswitch device drivers
#

source "drivers/huawei_platform/power/charger/charger_ap/direct_charger/loadswitch/dual_loadswitch/Kconfig"

config DUAL_LOADSWITCH
	bool "dual_loadswitch"
	default n
	help
	  Say Y here to enable dual loadswitch driver.
	  This driver provides a unified interface for dual loadswtich.
	  Support device:
	  dual_rt9748
	  dual_fpf2283

config RT9748
	bool "rt9748"
	default n
	help
	  Say Y here to enable rt9748 driver.
```

## drivers/huawei_platform/power/charger/charger_ap/direct_charger/loadswitch/dual_loadswitch/Kconfig
```kconfig
#
# huawei dual loadswitch device drivers
#

config DUAL_LOADSWITCH_RT9748
	bool "dual_loadswitch_rt9748"
	default n
	help
	  Say Y here to enable dual rt9748 driver.
	  RT9748 is a 6-A smart load switch battery charger, which integrates an
	  internal load switch with charge pump control and 4-path constant current
	  and constant voltage regulation, a 5-way hardware protection, and a 10-channel
	  12-bit ADC converter.

config DUAL_LOADSWITCH_FPF2283
	bool "dual_loadwitch_fpf2283"
	default n
	help
	  Say Y here to enable dual fpf2283 driver.
```

## drivers/huawei_platform/power/charger/charger_ap/direct_charger/switchcap/Kconfig
```kconfig
#
# huawei switchcap device drivers
#

config BQ25970
	bool "bq25970"
	default n
	help
	  Say Y here to enable bq25970 driver.
	  BQ25970 is a 97% efficient, 8-A battery charging solution using a
	  switched cap architecture.
	  This architecture and the integrated FETs are optimized to enable
	  a 50% duty cycle.

config LTC7820
	bool "ltc7820"
	default n
	help
	  Say Y here to enable ltc7820 driver.
	  LTC7820 is a fixed ratio high voltage high power switched capacitor
	  and charge pump controller.
	  This device achieves a 2:1 step-down ratio form an input voltage as
	  high as 72v.
```

## drivers/huawei_platform/power/charger/charger_ap/vbus_channel/Kconfig
```kconfig
#
# huawei vbus channel drivers
#

config VBUS_CHANNEL
	bool "vbus channel"
	default n
	help
	  Say Y here to enable vbus channel driver.
	  This driver provides a unified interface for the vbus.
	  Currently supported charger channel and boost gpio channel
	  as a VBUS output function.

config VBUS_CHANNEL_CHARGER
	bool "vbus channel with charger"
	depends on VBUS_CHANNEL
	default n
	help
	  Say Y here to enable vbus channel driver.
	  This configuration item depends on VBUS_CHANNEL_CHARGER.
	  This driver will implement a charger channel
	  as a VBUS output function.

config VBUS_CHANNEL_BOOST_GPIO
	bool "vbus channel with boost"
	depends on VBUS_CHANNEL
	default n
	help
	  Say Y here to enable vbus channel driver.
	  This configuration item depends on VBUS_CHANNEL_CHARGER.
	  This driver will implement a boost channel
	  as a VBUS output function.
```

## drivers/huawei_platform/power/charger/charger_ap/wired_channel_switch/Kconfig
```kconfig
#
# huawei wired channel switch drivers
#

config WIRED_CHANNEL_SWITCH
	bool "wired channel switch"
	default n
	help
	  Say Y here to enable wired channel switch driver.
	  This driver provides a unified interface for
	  wired channel. Current methods of controlling wired channel
	  include OVP or NCP3902.

config WIRED_CHANNEL_OVP_SWITCH
	bool "wired channel ovp switch"
	default n
	help
	  Say Y here to enable wired channel ovp switch driver.
	  This driver provides a unified interface for
	  wired channel ovp switch. OVP switch is used between charging IC and charger
	  to cut off VBUS when overvoltage occurs.

config WIRED_CHANNEL_NCP3902_SWITCH
	bool "wired channel ncp3902 switch"
	default n
	help
	  Say Y here to enable wired channel ncp3902 switch driver.
```

## drivers/huawei_platform/power/charger/charger_protocol/Kconfig
```kconfig
#
# huawei charger protocol drivers
#

config CHARGER_PROTOCOL
	bool "charger protocol"
	default n
	help
	  Say Y here to enable charger protocol driver.
	  This driver provides a unified interface to the charger protocol.
	  Currently supported charger protocols include Huawei's private SCP protocol.

config CHARGER_PROTOCOL_SCP
	bool "huawei charger protocol with scp"
	depends on CHARGER_PROTOCOL
	default n
	help
	  Say Y here to enable charger scp protocol driver.
```

## drivers/huawei_platform/power/coul/Kconfig
```kconfig
#
# huawei coul drivers
#

config HUAWEI_COUL
	bool "huawei coul"
	default n
	help
	  Say Y here to enable huawei coul driver.
	  This driver provides a unified interface to the coul.
	  Currently supported coul as below.
	  Support coul list: bq28z610

config BQ28Z610_COUL
	bool "bq28z610 coul"
	default n
	help
	  Say Y here to enable bq28z610 coul driver.
```

## drivers/huawei_platform/power/hardware_monitor/soc_control/Kconfig
```kconfig
#
# battery capacity control drivers
#

config HUAWEI_SOC_CONTROL
	bool "battery capacity control"
	default n
	help
	  Say Y here to enable battery capacity control driver.
	  In some scenarios, we need to control the capacity of the battery
	  in order to prevent the battery from working in high capacity area
	  for a long time and reduce the cycle life of the battery.
	  SOC: battery state of charge
```

## drivers/huawei_platform/power/power_debug/Kconfig
```kconfig
#
# huawei power debug drivers
#

config HUAWEI_POWER_DEBUG
	bool "huawei power debug module"
	default n
	help
	  Say Y here to enable power debug driver.
```

## drivers/huawei_platform/power/power_thermalzone/Kconfig
```kconfig
#
# huawei power thermalzone drivers
#

config HUAWEI_POWER_THERMALZONE
	bool "huawei power thermalzone temp"
	default n
	help
	  Say Y here to enable power thermalzone driver.
```

## drivers/huawei_platform/power/vsys_switch/Kconfig
```kconfig
config HUAWEI_VSYS_SWITCH
	bool "huawei vsys switch"
	default n
	help
	  Macro for vsys switch module
	  Vsys switch module controls the switching
	  between buck channel and sc channel to
	  achieve high efficiency

config HUAWEI_VSYS_SC_DA9313
	bool "huawei vsys sc da9313"
	depends on HUAWEI_VSYS_SWITCH
	default n
	help
	  Macro for sc da9313 driver
	  SC da9313 driver controls the basic
	  functions such as enable/disable, I2c
	  read/write

config HUAWEI_VSYS_OVP_SWITCH_FPF2283
	bool "huawei vsys ovp switch fpf2283"
	depends on HUAWEI_VSYS_SWITCH
	default n
	help
	  Macro for ovp switch fpf2283 driver
	  Ovp switch fpf2283 driver controls the
	  basic functions such as enable/disable,
	  I2C read/write

config HUAWEI_VSYS_BUCK_TPS62180
	bool "huawei vsys buck tps62180"
	depends on HUAWEI_VSYS_SWITCH
	default n
	help
	  Macro for buck tps62180 driver
	  Buck tps62180 driver controls the basic functions
	  such as enable/disable, output voltage value between
	  high and low
```

## drivers/huawei_platform/power/wifi_filter/Kconfig
```kconfig
config DOZE_FILTER
	tristate "Huawei doze wifi filter Support"
	---help---
        the wifi filter when enter doze mode,open it
config HW_STRICT_RST
	tristate "Send rst Support"
	---help---
        send reset when close socket,open it
```

## drivers/huawei_platform/sw/Kconfig
```kconfig
config HW_SW_DEVICES
    tristate "single-wire communicate Keyboard with UART in inputhub for CMR Product."
    default n
    bool "HUAWEI SW_DEVICES"
    help
	  This module adds support for single-wire communicate Keyboard for CMR Product based on
	  HISI 960 chipset.
```

## drivers/huawei_platform/usb/hw_hishow/Kconfig
```kconfig
#
# huawei hishow drivers
#

config HUAWEI_HISHOW
	bool "support huawei hishow function"
	default n
	help
	  Say Y here to enable hishow driver.
```

## drivers/huawei_platform/usb/hw_usb/Kconfig
```kconfig
#
# huawei usb drivers
#

config HUAWEI_USB
	bool "huawei usb"
	default n
	help
	  Say Y here to enable usb driver.
```

## drivers/huawei_platform/usb/hw_ycable/Kconfig
```kconfig
#
# huawei ycable drivers
#

config HUAWEI_YCABLE
	bool "HUAWEI_YCABLE support"
	default n
	help
	  Say Y here to enable ycable driver.
```

## drivers/huawei_platform/usb/pd/Kconfig
```kconfig
source "drivers/huawei_platform/usb/pd/ti/Kconfig"
source "drivers/huawei_platform/usb/pd/richtek/Kconfig"

config TYPEC_CAP_CUSTOM_SRC2
        bool "Support Double 22/10k Pullup Function"
        default n
        help
          Say Y to enable
```

## drivers/huawei_platform/usb/sw/Kconfig
```kconfig
#
# huawei single-wire devices drivers
#

config HW_SW_DEVICES
	tristate "Single-wire communicate Keyboard with UART"
	default n
	help
	  Say m here to build single-wire driver module.
```

## drivers/huawei_platform/usb/typec/Kconfig
```kconfig
#
# huawei Type C Connector drivers
#

config HUAWEI_TYPEC
	tristate "typec connector"
	depends on GPIOLIB && I2C
	default n
	help
	  Say Y here to enable Type C Connector driver.
	  This driver provides a unified interface for the Type C Connector.
	  Currently supported typec device as below:
	  pericom30216 (Pericom)
	  tusb320 (TI)
	  fusb301 (Fairchild)
	  ptn5150h (Nxp)

source "drivers/huawei_platform/usb/typec/pericom30216/Kconfig"
source "drivers/huawei_platform/usb/typec/tusb320/Kconfig"
source "drivers/huawei_platform/usb/typec/fusb301/Kconfig"
source "drivers/huawei_platform/usb/typec/ptn5150h/Kconfig"
```

## drivers/media/huawei/camera/fpga/Kconfig
```kconfig
if HISI_CAMERA_FPGA

config HISI_CAMERA_FPGA_ICE40
    tristate "ice40 camera fpga driver"
    depends on HISI_CAMERA_FPGA
    default n
    ---help---
        ice40 camera fpga driver

config HISI_CAMERA_FPGA_STM32
    tristate "stm32 camera fpga driver"
    depends on HISI_CAMERA_FPGA
    default n
    ---help---
        stm32 camera fpga driver
endif
```

## drivers/oae_fw_patch/Kconfig
```kconfig
menuconfig OAE_FW_PATCH
        tristate "Qihoo framework patch"
        default y
        help
          Qihoo framework patch

if OAE_FW_PATCH

config OAE_DM_ROOT
        tristate "Use oae dm as boot device"
        default n
        help
         Use oae dm as boot device.
endif # OAE_FW_PATCH
```

## drivers/power/hisi/asw/Kconfig
```kconfig
#
# hisi battery hisi_asw drivers
#

config HISI_ASW
	bool "hisi battery asw protect battery"
	default n
	help
	  Say Y here to enable hisi asw protect battery.
```

## drivers/reclaim_acct/Kconfig
```kconfig
config HW_RECLAIM_ACCT
	bool "Huawei memory reclaim delay accounting"
	default n
	help
	  Huawei memory reclaim delay accounting. Never use it as a kernel module.
```
