## drivers/storage_rofa/Kconfig
```kconfig
#
# Huawei storage_rofa drivers configuration
#

config HUAWEI_STORAGE_ROFA
       bool "Huawei storage readonly First Aid module"
       default n
       help
         Huawei storage readonly boot solution.

         If unsure, say N.

config HUAWEI_STORAGE_ROCHK
       bool "Huawei storage readonly check module"
       default n
       ---help---
         Huawei storage readonly check misc device.

config HUAWEI_DYNAMIC_BRD
       bool "Huawei dynamic create ramdisk"
       default n
       depends on BLK_DEV_RAM
       help
         Create a given size ramdisk dynamicly.

         If unsure, say N.

config HUAWEI_STORAGE_ROW
       bool "Huawei redirection on write DM"
       default n
       depends on MD
       ---help---
         This device-mapper target is virtually a ROW target. This
         target is setup by reading a string table.
```

## drivers/usb/dwc3/hisi/Kconfig
```kconfig
config USB_DWC3_HISI
	tristate "Hisilicon Platforms"
	default USB_DWC3
	help
	  Support of USB2/3 functionality in hisilicon platforms,
	  Say 'Y' or 'M' here if you have one such device.

if USB_DWC3_HISI

config USB_DWC3_NOV
       tristate "Hisilicon Platforms NOV USB"
       default n
       help
         Support of USB2 functionality in hisilicon platforms,
         Say 'Y' or 'M' here if you have one such device.

config USB_DWC3_OCT
       tristate "Hisilicon Platforms OCT USB"
       default n
       help
         Support of USB2 functionality in hisilicon platforms,
         Say 'Y' or 'M' here if you have one such device.

config USB_DWC3_APR
	tristate "Hisilicon Platforms APR USB"
	default n
	help
	  Support of USB2/3/3.1 functionality in hisilicon platforms,
	  Say 'Y' or 'M' here if you have one such device.

config USB_DWC3_MAR
	tristate "Hisilicon Platforms MAR USB"
	default n
	help
	  Support of USB2/3/3.1 functionality in hisilicon platforms,
	  Say 'Y' or 'M' here if you have one such device.

config USB_DWC3_FEB
	tristate "Hisilicon Platforms FEB USB"
	default n
	help
	  Support of USB2/3 functionality in hisilicon platforms,
	  Say 'Y' or 'M' here if you have one such device.

config USB_DWC3_JAN
	tristate "Hisilicon Platforms JAN USB"
	default n
	help
	  Support of USB2/3 functionality in hisilicon platforms,
	  Say 'Y' or 'M' here if you have one such device.

config USB_DWC3_VBUS_PLT
	tristate "Hisilicon Platforms USB VBUS usb platform drv intf"
	depends on HISI_PMIC
	default n
	help
	  Use platform bus register usb insert/pull-out interrupt.

config USB_DWC3_VBUS_SPMI
	tristate "Hisilicon Platforms USB VBUS usb spmi drv intf"
	depends on HISI_SPMI
	default n
	help
	  Use spmi bus register usb insert/pull-out interrupt.

config USB_DWC3_NYET_ABNORMAL
	bool "Enable workaround for receiving NYET bug on hisi dwc3 feb"
	default n
	help
	  There is a Bug that receiving NYET in control transfer
	  can cause controller abnormal on hisi dwc3 feb.

endif # USB_DWC3_HISI

config HISI_USB_DWC3_MASK_IRQ_WORKAROUND
	bool "Enable workaround for hisi dwc3 mask irq bug"
	depends on USB_DWC3_HISI
	default n
	help
	  For some hisi dwc3, masking dwc3 irq can't work well.
	  Say Y here if you have such problem.

comment "Debugging features"



config USB_DWC3_OTG
	bool "Enable DWC3 OTG"
	default n
	help
	  Say Y here to enable DWC3 OTG feature.


config CONTEXTHUB_PD
	bool "Sensor CONTEXTHUB PD driver"
	default n
	help
	  Say yes here if you want to use contexthub pd function
```

## drivers/usb/hisi-usb-typec/Kconfig
```kconfig
config HISI_USB_TYPEC
	bool "Hisilicon USB Typei-C Driver"
	help
	  Say Y to enable Hisilicon USB Typec Driver

config HISI_USB_TYPEC_DBG
	bool "Hisilicon USB Type-C driver verbost debug infomation."
	depends on HISI_USB_TYPEC
	help
	  Say Y here if you want verbost debug infomation. If unsure, say N.

source "drivers/usb/hisi-usb-typec/hisi-tcpc/Kconfig"
```

## drivers/usb/hisi-usb-typec/hisi-tcpc/Kconfig
```kconfig
config HISI_TCPC
	bool "Hisilicon TypeC Port Controller Device"
	help
	  Say Y to enable Hisilicon Typec Port Controller Driver

if HISI_TCPC

config HISI_TCPC_DEBUG
	bool "Hisilicon TypeC Driver verbose debug information."
	default n
	help
	  If unsure, say N.

config HISI_TCPC_HI6526
	bool "Hisilicon hi6526 Type-C Port Controller support"
	default n
	help
	  Say Y to enable Hisilicon hi6525 support

config TYPEC_CAP_DBGACC_SNK_SUPPORT
	bool "DebugAccessory sink support"
	default n
	help
	  Debug Accessory sink support.

config TYPEC_CAP_CUSTOM_SRC_SUPPORT
	bool "Custom SRC support"
	default n
	help
	  Custom SRC support

config TCPC_VSAFE0V_DETECT_SUPPORT
	bool "TCPC Vsafe0V detect support"
	default n
	help
	  TCPC Vsafe0V detect support

config USB_POWER_DELIVERY_SUPPORT
	bool "Hisilicon Power Delivery Support"
	help
	  Support PD using hisi tcpc.

config USB_PD_ALT_MODE_SUPPORT
	bool "Alternate Mode support"
	default n
	help
	  Alternate Mode support

config USB_PD_ALT_MODE_DFP_SUPPORT
	bool "Alternate Mode DFP support"
	default n
	help
	  Alternate Mode DFP support

config USB_PD_UVDM_SUPPORT
	bool "USB PD Unstructed VDM support"
	default n
	help
	  USB PD Unstructed VDM support

config USB_PD_CUSTOM_DBGACC_SUPPORT
	bool "Custom Debug Accessory support"
	default n
	help
	  Custom Debug Accessory support

endif
```

## kernel/hwqos/Kconfig
```kconfig
config HW_QOS_THREAD
    bool "iaware 5.0 qos thread"
    default n
    help
      if set, qos thread is propagated by lock&binder, and picked first in lock's waitlist
```

## security/check_double_free/Kconfig
```kconfig
config HW_DOUBLE_FREE_DYNAMIC_CHECK
	bool "hw double free dynamic check"
	default n
	help
	support double free check function.
	upload the call stack information to.
	hisecd when double free happen.
```

## security/check_root/Kconfig
```kconfig
config HUAWEI_PROC_CHECK_ROOT
	bool "/proc/check_root support"
	default n
	help
	support check_root setid function.
```

## security/hkip_atkinfo/Kconfig
```kconfig
config HKIP_ATKINFO
	bool "Upload HKIP attack information"
	depends on HISI_HHEE
	default n
	help
	Upload the attack information reported by HKIP to Huawei server.

config HKIP_ATKINFO_DEBUGFS
	bool "Upload HKIP attack information debugfs"
	depends on HKIP_ATKINFO
	default n
	help
	The debugfs interface for the feature of uploading the attack information.
```

## security/hw_root_scan/Kconfig
```kconfig
#
# Copyright (c) Huawei Technologies Co., Ltd. 2016-2018. All rights reserved.
# Description: Huawei root scanner configuration
# Author:likun <quentin.lee@huawei.com>
# Create: 2016-06-18
#

menu "Huawei root scanner"

config HW_ROOT_SCAN
	tristate "enables Huawei root scanner"
	default n
	help
	  This option enables support for Huawei root scanner in kernel space.
	  Huawei root scanner will check if the device is got rooting or not
	  base on five items, kernel code integrity, system call table
	  integrity, SeLinux status, SeLinux hooks status, and root processes.

config HW_ROOT_SCAN_ENG_DEBUG
	bool "Huawei root scanner for engineering mode debug"
	depends on HW_ROOT_SCAN
	default n
	help
	  This option should only be enabled for engineering mode & debug test.
	  In engineering mode, root scanner will be turnoff(default) after init,
	  tester can use supported interface to turn it on, and do debug test.

endmenu
#a blank line must be existed
```

## security/kernel_stp/Kconfig
```kconfig
#
# Copyright (c) Huawei Technologies Co., Ltd. 2018-2018. All rights reserved.
# Description: Huawei kernel mdpp selftest configuration
# Author: sunhongqing <sunhongqing@huawei.com>
# Cryptographic API Configuration
# Create: 2018-03-31
#

menu "Huawei KERNEL STP"

config HW_KERNEL_STP
	tristate "enables Huawei KERNEL STP"
	default n
	help
	  This option enables support for Huawei kernel stp in kernel space.
	  Huawei kernel stp is a security threat perception module at kernel.
	  each source of threat can report the risk info to native throught the kernel stp

config HW_KERNEL_STP_ENG_DEBUG
	bool "Huawei KERNEL STP for engineering mode debug"
	depends on HW_KERNEL_STP
	default n
	help
	  This option should only be enabled for engineering mode & debug test.
	  In engineering mode, more debug info can be print for tester.

endmenu
```

## security/mdpp_selftest/Kconfig
```kconfig
#
# Copyright (c) Huawei Technologies Co., Ltd. 2017-2018. All rights reserved.
# Description: Cryptographic API Configuration
# Author: wangtienan <wangtienan@huawei.com>
# Create: 2017-09-23
#

menu "Huawei kernel mdpp selftest"

config HUAWEI_CRYPTO_TEST_MDPP
	tristate "MDPP selftest module"
	select CRYPTO_MANAGER
	help
	  Tests for a subset of crypto algo.

endmenu
#a blank line must be existed
```
